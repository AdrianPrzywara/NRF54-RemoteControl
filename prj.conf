## CMakeLists.txt
```
cmake_minimum_required(VERSION 3.20.0)
find_package(Zephyr REQUIRED HINTS $ENV{ZEPHYR_BASE})
project(remotecontrol)

add_subdirectory(src)
```

## Kconfig
```
source "Kconfig.zephyr"

config GPIO_BUTTON
    bool "GPIO Button Switching"
    depends on GPIO
    help
      Demonstrates how to use GPIO buttons and LEDs with Zephyr.
    default n
```

## prj.conf
```kconfig
# =========================================================
# Basic system configuration
# =========================================================
CONFIG_GPIO=y
CONFIG_GPIO_BUTTON=y

CONFIG_LOG=y

CONFIG_SERIAL=y
CONFIG_UART_ASYNC_API=y
CONFIG_LOG_PRINTK=n

CONFIG_TIMESLICING=y
CONFIG_TIMESLICE_SIZE=10
CONFIG_TIMESLICE_PRIORITY=0
```

## xiao_nrf54l15_nrf54l15_cpuapp.overlay
```dts
// To get started, press Ctrl+Space to bring up the completion menu and view the available nodes.

// You can also use the buttons in the sidebar to perform actions on nodes.
// Actions currently available include:

// * Enabling / disabling the node
// * Adding the bus to a bus
// * Removing the node
// * Connecting ADC channels

// For more help, browse the DeviceTree documentation at https://docs.zephyrproject.org/latest/guides/dts/index.html
// You can also visit the nRF DeviceTree extension documentation at https://docs.nordicsemi.com/bundle/nrf-connect-vscode/page/guides/ncs_configure_app.html#devicetree-support-in-the-extension

&uart20 {
    current-speed = <115200>;
    hw-flow-control;
    data-bits = <8>;
    stop-bits = "1";
    parity = "none";
};
```

## src/main.c
```c
/* Main application file */


/***************************************************** Includes ******************************************************/

#include <stdio.h>
#include <zephyr/kernel.h>
#include <zephyr/sys/printk.h>

#ifdef CONFIG_GPIO_BUTTON
#include "gpio_button.h"
#endif /* CONFIG_GPIO_BUTTON */

/****************************************************** Defines ******************************************************/

/***************************************************** Variables *****************************************************/

/******************************************** Local functions declarations *******************************************/

/******************************************** Local functions definitions ********************************************/

/******************************************* Exported functions definitions ******************************************/
int main(void)
{
#ifdef CONFIG_GPIO_BUTTON
	printk("GPIO Button Switching Enabled\n");
	Gpio_LedInit();
	Gpio_ButtonInit();
#else
	printk("GPIO Button Switching Disabled\n");
#endif /* CONFIG_GPIO_BUTTON */

	for (;;)
	{
		k_yield();
	}
}
```

## inc/gpio_button.h
```c
#ifndef GPIO_BUTTON_H
#define GPIO_BUTTON_H

/****************************************************** Defines ******************************************************/

#include <zephyr/drivers/gpio.h>

/******************************************* Exported functions definitions ******************************************/

void Gpio_LedInit(void);
void Gpio_ButtonInit(void);

#endif /* GPIO_BUTTON_H */
```

## src/gpio_button.c
```c
/*
 * @file gpio_button.c
 *
 * @brief This file contains the implementation of the GPIO button and LED initialization and handling.
 *
 * @author [Your Name]
 * @date [Date]
 */


/***************************************************** Includes ******************************************************/

#include "gpio_button.h"

/****************************************************** Defines ******************************************************/

#define LED0_NODE DT_ALIAS(led0)
#define SW0_NODE DT_ALIAS(sw0)

/***************************************************** Variables *****************************************************/

static const struct gpio_dt_spec led = GPIO_DT_SPEC_GET(LED0_NODE, gpios);
static const struct gpio_dt_spec button = GPIO_DT_SPEC_GET(SW0_NODE, gpios);

static struct gpio_callback button_cb_data;

/******************************************** Local functions declarations *******************************************/

static void button_pressed(const struct device *dev, struct gpio_callback *cb, gpio_port_pins_t  pins);

/******************************************** Local functions definitions ********************************************/

static void button_pressed(const struct device *dev, struct gpio_callback *cb, gpio_port_pins_t  pins)
{
    gpio_pin_toggle_dt(&led);
    printk("Button pressed at %" PRIu32 "\n", k_cycle_get_32());
}

/******************************************* Exported functions definitions ******************************************/

void Gpio_LedInit(void)
{
    /* Initialization */
    if ((!gpio_is_ready_dt(&led)) ||
        (gpio_pin_configure_dt(&led, GPIO_OUTPUT_ACTIVE) < 0))
    {
        /* Initialization failed */
    }
}

void Gpio_ButtonInit(void)
{
    /* Initialization */
    if ((!gpio_is_ready_dt(&button)) ||
        (gpio_pin_configure_dt(&button, GPIO_INPUT) < 0) ||
        (gpio_pin_interrupt_configure_dt(&button, GPIO_INT_EDGE_TO_ACTIVE) < 0))
    {
        /* Initialization failed */
    }
    else
    {
        /* Initialization successful, add interrupt callback */
        gpio_init_callback(&button_cb_data, &button_pressed, BIT(button.pin));
        gpio_add_callback(button.port, &button_cb_data);
    }
}
```
